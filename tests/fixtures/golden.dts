/dts-v1/;
/plugin/;

/*
 * Generated by rp1-overclock-tool generate_dtbo.py
 * Source kernel: 6.99.0-fixture+rpt-common-rpi
 * pll_sys_core = 1000000000 Hz (slot 0)
 * Target: RP1_PLL_SYS + RP1_CLK_SYS = pll_sys_core / 3
 *         = 333333333 Hz (= 333.333 MHz)
 *
 * All non-target slots are pinned to the values the live kernel
 * already programmed, so nothing else moves.
 */

/ {
	compatible = "brcm,bcm2712";
	fragment@0 {
		target = <&rp1_clocks>;
		__overlay__ {
			assigned-clock-rates = <
				/* RP1_PLL_SYS_CORE         */ 1000000000
				/* RP1_PLL_AUDIO_CORE       */ 1536000000
				/* RP1_PLL_SYS              [TARGET] */ 333333333
				/* RP1_PLL_SYS_SEC          */ 125000000
				/* RP1_CLK_ETH              */ 125000000
				/* RP1_PLL_AUDIO            */ 61440000
				/* RP1_PLL_AUDIO_SEC        */ 153600000
				/* RP1_CLK_SYS              [TARGET] */ 333333333
				/* RP1_PLL_SYS_PRI_PH       */ 100000000
				/* RP1_CLK_SLOW_SYS         */ 50000000
				/* RP1_CLK_SDIO_TIMER       */ 1000000
				/* RP1_CLK_SDIO_ALT_SRC     */ 200000000
				/* RP1_CLK_ETH_TSU          */ 50000000
			>;
		};
	};
};
